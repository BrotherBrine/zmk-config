## boards/shields/zplit/Kconfig.defconfig
```kconfig
if SHIELD_ZPLIT_LEFT

config ZMK_KEYBOARD_NAME
    default "zplit"

config ZMK_SPLIT_ROLE_CENTRAL
    default y

endif

if SHIELD_ZPLIT_LEFT || SHIELD_ZPLIT_RIGHT
    
config ZMK_SPLIT
    default y

endif
```

## boards/shields/zplit/Kconfig.shield
```kconfig
config SHIELD_ZPLIT_LEFT
    def_bool $(shields_list_contains,zplit_left)

config SHIELD_ZPLIT_RIGHT
    def_bool $(shields_list_contains,zplit_right)
```

## config/boards/shields/dactyl_manuform_5x6/Kconfig.defconfig
```kconfig
if SHIELD_DACTYL_MANUFORM_5X6_LEFT || SHIELD_DACTYL_MANUFORM_5X6_RIGHT

config ZMK_KEYBOARD_NAME
    default "Dactyl Manuform 5x6"

config ZMK_SPLIT
    default y

if SHIELD_DACTYL_MANUFORM_5X6_LEFT

config ZMK_SPLIT_ROLE_CENTRAL
    default y

endif # SHIELD_DACTYL_MANUFORM_5X6_LEFT

endif # SHIELD_DACTYL_MANUFORM_5X6_LEFT || SHIELD_DACTYL_MANUFORM_5X6_RIGHT
```

## config/boards/shields/ortho_4x6/Kconfig.defconfig
```kconfig
if SHIELD_ORTHO_4X6_LEFT || SHIELD_ORTHO_4X6_RIGHT

config ZMK_KEYBOARD_NAME
    default "Ortho 4x6"

config ZMK_SPLIT
    default y

if SHIELD_ORTHO_4X6_LEFT

config ZMK_SPLIT_ROLE_CENTRAL
    default y

endif # SHIELD_ORTHO_4X6_LEFT

if SHIELD_ORTHO_4X6_RIGHT

config ZMK_SPLIT_ROLE_CENTRAL
    default n

endif # SHIELD_ORTHO_4X6_RIGHT

endif # SHIELD_ORTHO_4X6_LEFT || SHIELD_ORTHO_4X6_RIGHT
```

## config/boards/shields/ortho_4x6/Kconfig.shield
```kconfig
config SHIELD_ORTHO_4X6_LEFT
    def_bool $(shields_list_contains,ortho_4x6_left)

config SHIELD_ORTHO_4X6_RIGHT
    def_bool $(shields_list_contains,ortho_4x6_right)
```
