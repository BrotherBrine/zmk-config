/*
 * Dactyl Manuform 5x6 — Left half GPIO configuration
 *
 * ╔══════════════════════════════════════════════════════════════════╗
 * ║  IMPORTANT: Adjust pin assignments to match your hand-wiring!  ║
 * ║                                                                  ║
 * ║  nice!nano v2 GPIO banks:                                        ║
 * ║    gpio0 = Port 0 (P0.xx)   gpio1 = Port 1 (P1.xx)             ║
 * ║                                                                  ║
 * ║  Suggested wiring (change to suit your build):                   ║
 * ║    ROW pins: P0.06, P0.08, P0.17, P0.20, P0.22, P0.24          ║
 * ║    COL pins: P1.00, P1.01, P1.02, P1.03, P1.04, P1.05          ║
 * ║                                                                  ║
 * ║  Diode direction: col2row                                        ║
 * ║    → Diode cathode (banded end) connects to the ROW wire        ║
 * ║    → Diode anode connects to the switch, then the COL wire      ║
 * ╚══════════════════════════════════════════════════════════════════╝
 */

#include "dactyl_manuform_5x6.dtsi"

/ {
    kscan0: kscan {
        compatible = "zmk,kscan-gpio-matrix";
        diode-direction = "col2row";

        /*
         * Row order must match the row numbering in the matrix transform.
         * R0 = number row, R1 = QWERTY, R2 = home, R3 = bottom,
         * R4 = mod row,    R5 = thumb cluster
         */
        row-gpios
            = <&gpio0 6  (GPIO_ACTIVE_HIGH | GPIO_PULL_DOWN)>   /* R0 */
            , <&gpio0 8  (GPIO_ACTIVE_HIGH | GPIO_PULL_DOWN)>   /* R1 */
            , <&gpio0 17 (GPIO_ACTIVE_HIGH | GPIO_PULL_DOWN)>   /* R2 */
            , <&gpio0 20 (GPIO_ACTIVE_HIGH | GPIO_PULL_DOWN)>   /* R3 */
            , <&gpio0 22 (GPIO_ACTIVE_HIGH | GPIO_PULL_DOWN)>   /* R4 */
            , <&gpio0 24 (GPIO_ACTIVE_HIGH | GPIO_PULL_DOWN)>   /* R5 (thumb) */
            ;

        /*
         * Col order must match the col numbering in the matrix transform
         * for the LEFT half (cols 0-5).
         * Wire outermost column (pinky side) to C0.
         */
        col-gpios
            = <&gpio1 0 GPIO_ACTIVE_HIGH>   /* C0 — outermost (pinky) */
            , <&gpio1 1 GPIO_ACTIVE_HIGH>   /* C1 */
            , <&gpio1 2 GPIO_ACTIVE_HIGH>   /* C2 */
            , <&gpio1 3 GPIO_ACTIVE_HIGH>   /* C3 */
            , <&gpio1 4 GPIO_ACTIVE_HIGH>   /* C4 */
            , <&gpio1 5 GPIO_ACTIVE_HIGH>   /* C5 — innermost (index) */
            ;
    };
};
