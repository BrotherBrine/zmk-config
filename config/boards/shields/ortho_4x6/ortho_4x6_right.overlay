/*
 * Ortho 4x6 — Right half GPIO configuration
 *
 * Rows (bottom → top):  P1.06, P1.04, P0.11, P1.00
 *
 * col-offset = 8 (number of left-half columns) is set below so the
 * peripheral adds 8 to each local col before looking up the transform.
 *
 * Col order (local → combined):
 *   C0 (thumb RT0) → combined  8  RC(0, 8)
 *   C1 (thumb RT1) → combined  9  RC(0, 9)
 *   C2 (innermost main / index) → combined 10
 *   C3 → combined 11
 *   C4 → combined 12
 *   C5 → combined 13
 *   C6 → combined 14
 *   C7 (outermost main / pinky) → combined 15
 *
 * Diode direction: row2col
 */

#include "ortho_4x6.dtsi"

&default_transform {
    col-offset = <8>;
};

/ {
    kscan0: kscan {
        compatible = "zmk,kscan-gpio-matrix";
        diode-direction = "row2col";

        row-gpios
            = <&gpio1 6  GPIO_ACTIVE_HIGH>   /* R0 — bottom row (main + thumb) */
            , <&gpio1 4  GPIO_ACTIVE_HIGH>   /* R1 */
            , <&gpio0 11 GPIO_ACTIVE_HIGH>   /* R2 */
            , <&gpio1 0  GPIO_ACTIVE_HIGH>   /* R3 — top row */
            ;

        col-gpios
            = <&gpio0 24 (GPIO_ACTIVE_HIGH | GPIO_PULL_DOWN)>   /* C0 — thumb RT0        → combined  8 */
            , <&gpio0 29 (GPIO_ACTIVE_HIGH | GPIO_PULL_DOWN)>   /* C1 — thumb RT1        → combined  9 */
            , <&gpio0 9  (GPIO_ACTIVE_HIGH | GPIO_PULL_DOWN)>   /* C2 — innermost (index)→ combined 10 */
            , <&gpio0 10 (GPIO_ACTIVE_HIGH | GPIO_PULL_DOWN)>   /* C3                    → combined 11 */
            , <&gpio1 11 (GPIO_ACTIVE_HIGH | GPIO_PULL_DOWN)>   /* C4                    → combined 12 */
            , <&gpio1 13 (GPIO_ACTIVE_HIGH | GPIO_PULL_DOWN)>   /* C5                    → combined 13 */
            , <&gpio1 15 (GPIO_ACTIVE_HIGH | GPIO_PULL_DOWN)>   /* C6                    → combined 14 */
            , <&gpio0 2  (GPIO_ACTIVE_HIGH | GPIO_PULL_DOWN)>   /* C7 — outermost (pinky)→ combined 15 */
            ;
    };
};
